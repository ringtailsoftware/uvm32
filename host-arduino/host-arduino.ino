#include "config.h"
#include "uvm32.h"
#include "common/uvm32_common_custom.h"

// Precompiled binary program to print integers
// This code expects to print via syscall 0x13C (UVM32_SYSCALL_PRINTDEC in common/uvm32_common_custom.h)
uint8_t rom[] = {
  0x23, 0x26, 0x11, 0x00, 0xef, 0x00, 0xc0, 0x00, 0xb7, 0x08, 0x00, 0x01,
  0x73, 0x00, 0x00, 0x00, 0x37, 0xf5, 0xff, 0xff, 0xb7, 0x15, 0x00, 0x00,
  0x37, 0xe6, 0xff, 0xff, 0x13, 0x07, 0xf0, 0x01, 0xb7, 0x47, 0x00, 0x00,
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  0x6f, 0x20, 0x77, 0x6f, 0x72, 0x6c, 0x64, 0x00
};

// Create an identifier for our host handler
typedef enum {
    F_PRINTDEC,
    F_PRINTLN,
    F_PUTC,
} f_code_t;

// Map VM syscall UVM32_SYSCALL_PRINTDEC to F_PRINTDEC, tell VM to expect write of a U32
const uvm32_mapping_t env[] = {
    { UVM32_SYSCALL_PRINTDEC, F_PRINTDEC, UVM32_SYSCALL_TYP_U32_WR },
    { UVM32_SYSCALL_PUTC, F_PUTC, UVM32_SYSCALL_TYP_U32_WR },
    { UVM32_SYSCALL_PRINTLN, F_PRINTLN, UVM32_SYSCALL_TYP_BUF_TERMINATED_WR },
};

uvm32_state_t vmst;
uvm32_evt_t evt;
bool isrunning = false;
uint32_t led_time = 0;
bool led_state = false;

void setup(void) {
    Serial.begin(115200);
    pinMode(LED_BUILTIN, OUTPUT);
    isrunning = false;
}

void loop(void) {
    // flash LED rapidly to show main loop is still running
    if (millis() > led_time + 50) {
        digitalWrite(LED_BUILTIN, led_state);
        led_state = !led_state;
        led_time = millis();
    }

    if (isrunning) {
        uvm32_run(&vmst, &evt, 100);   // num instructions before vm considered hung

        switch(evt.typ) {
            case UVM32_EVT_END:
                isrunning = false;
            break;
            case UVM32_EVT_SYSCALL:    // vm has paused to handle UVM32_SYSCALL
                switch((f_code_t)evt.data.syscall.code) {
                    case F_PRINTDEC:
                        Serial.println(evt.data.syscall.val.u32);
                    break;
                    case F_PUTC:
                        Serial.print((char)evt.data.syscall.val.u32);
                    break;
                    case F_PRINTLN:
                        for (int i=0;i<evt.data.syscall.val.buf.len;i++) {
                            Serial.print((char)evt.data.syscall.val.buf.ptr[i]);
                        }
                        Serial.println("");
                    break;
                }
            break;
            case UVM32_EVT_ERR:
                Serial.print("Error: ");
                Serial.println(evt.data.err.errstr);
                isrunning = false;
            break;
            case UVM32_EVT_YIELD:
            break;
        }
    } else {
        Serial.println("Starting VM");
        // setup vm
        uvm32_init(&vmst, env, sizeof(env) / sizeof(env[0]));
        uvm32_load(&vmst, rom, sizeof(rom));
        isrunning = true;
        delay(2000);
    }

    return;
}
